## tools/sensor-sim/sdkconfig.defaults
```kconfig
CONFIG_IDF_TARGET="esp32c6"
CONFIG_BT_ENABLED=y
CONFIG_BT_NIMBLE_ENABLED=y
CONFIG_BT_NIMBLE_EXT_ADV=y
CONFIG_BT_NIMBLE_MAX_EXT_ADV_INSTANCES=2
CONFIG_BT_NIMBLE_MAX_CONNECTIONS=4
CONFIG_BT_LE_MAX_CONNECTIONS=4
CONFIG_BT_NIMBLE_ROLE_CENTRAL=n
CONFIG_BT_NIMBLE_ROLE_OBSERVER=n
CONFIG_BT_NIMBLE_HCI_EVT_BUF_SIZE=70
CONFIG_BT_NIMBLE_LOG_LEVEL_WARNING=y
CONFIG_ESP_CONSOLE_USB_SERIAL_JTAG=y
```
